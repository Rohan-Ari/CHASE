## CMakeLists.txt
```
cmake_minimum_required(VERSION 3.20.0)
find_package(Zephyr REQUIRED HINTS $ENV{ZEPHYR_BASE})

project(program)

target_sources(app PRIVATE src/main.c)

target_sources(app PRIVATE src/remote.c)

# zephyr_library_include_directories()
```

## prj.conf
```kconfig
# Enable DK LED and Buttons Library
CONFIG_GPIO=y
CONFIG_DK_LIBRARY=y

# Config logger
CONFIG_LOG=y
CONFIG_USE_SEGGER_RTT=n
CONFIG_LOG_BACKEND_RTT=n
CONFIG_LOG_BACKEND_UART=y
COFNIG_LOG_DEFAULT_LEVEL=3

# Config bluetooth
CONFIG_BT=y
CONFIG_BT_PERIPHERAL=y
CONFIG_BT_DEVICE_NAME="Remote_controller"
CONFIG_BT_DEVICE_APPEARANCE=0
CONFIG_BT_MAX_CONN=1
CONFIG_BT_LL_SOFTDEVICE=y

CONFIG_ASSERT=y
```

## src/main.c
```c
#include <zephyr/kernel.h>
#include <logging/log.h>
#include <dk_buttons_and_leds.h>
#include "remote.h"

#define LOG_MODULE_NAME app
LOG_MODULE_REGISTER(LOG_MODULE_NAME)

int main(void)
{
        int err;
        err = bluetooth_init();
        if(err) {
                LOG_ERR("Bluetooth init returned %d", err);
        }
        LOG_INF("Running...")
        return 0;
}
```

## src/remote.c
```c
#include "remote.h"

#define LOG_MODULE_NAME remote
LOG_MODULE_REGISTER(LOG_MODULE_NAME);

static K_SEM_DEFINE(bt_init_ok, 1 1);

#define DEVICE_NAME CONFIG_BT_DEVICE_NAME
#define DEVICE_NAME_LEN (sizeof(DEVICE_NAME)-1)

static const struct bt_data ad[] = {
    BT_DATA_BYTES(BT_DATA_FLAGS, (BT_LE_AD_GENERAL | BT_LE_AD_NO_BREDR)),
    BT_DATA(BT_DATA_NAME_COMPLETE, DEVICE_NAME, DEVICE_NAME_LEN)
};

static const struct bt_data sd[] = {
    BT_DATA_BYTES(BT_DATA_UUID128_ALL, BT_UUID_REMOTE_SERV_VAL),
};

void bt_ready(int err) {
    if(err) {
        LOG_ERR("bt_enable returned %d", err);
    }
    
    k_sem_give(&bt_init_ok);
}

int bluetooth_init(void) {
    int err;
    LOG_INF("Initializing bluetooth");
    err = bt_enable(bt_ready);
    if(err) {
        LOG_ERR("bt_enable returned %d", err);
        return err;
    }

    k_sem_take(&bt_init_ok, K_FOREVER)

    err = bt_le_adv_start(BT_LE_ADV_CONN, ad, ARRAY_SIZE(ad), sd, ARRAY_SIZE(sd));
    if (err) {
        LOG_ERR("Couldn't start advertising (err = %d)", err);
        return err;
    }

    return err;
}
```

## src/remote.h
```c
#include <zephyr/kernel.h>
#include <logging/log.h>

#include <bluetooth/bluetooth.h>
#include <bluetooth/uuid.h>
#include <bluetooth/gat.h>
#include <bluetooth/hci.h>

int bluetooth_init(void);
```
